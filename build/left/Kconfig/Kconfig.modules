## build/left/Kconfig/Kconfig.modules
```kconfig
menu "zmk (/Users/giulio/git/zmk-config-gnf/zmk)"
osource "/Users/giulio/git/zmk-config-gnf/zmk/zephyr/Kconfig"
config ZEPHYR_ZMK_MODULE
	bool
	default y
endmenu
menu "nanopb (/Users/giulio/git/zmk-config-gnf/modules/lib/nanopb)"
osource "$(ZEPHYR_NANOPB_KCONFIG)"
config ZEPHYR_NANOPB_MODULE
	bool
	default y
endmenu
menu "acpica (/Users/giulio/git/zmk-config-gnf/modules/lib/acpica)"
osource "$(ZEPHYR_ACPICA_KCONFIG)"
config ZEPHYR_ACPICA_MODULE
	bool
	default y
endmenu
menu "canopennode (/Users/giulio/git/zmk-config-gnf/modules/lib/canopennode)"
osource "$(ZEPHYR_CANOPENNODE_KCONFIG)"
config ZEPHYR_CANOPENNODE_MODULE
	bool
	default y
endmenu
menu "cmsis (/Users/giulio/git/zmk-config-gnf/modules/hal/cmsis)"
osource "$(ZEPHYR_CMSIS_KCONFIG)"
config ZEPHYR_CMSIS_MODULE
	bool
	default y
endmenu
menu "cmsis-dsp (/Users/giulio/git/zmk-config-gnf/modules/lib/cmsis-dsp)"
osource "$(ZEPHYR_CMSIS_DSP_KCONFIG)"
config ZEPHYR_CMSIS_DSP_MODULE
	bool
	default y
endmenu
menu "cmsis-nn (/Users/giulio/git/zmk-config-gnf/modules/lib/cmsis-nn)"
osource "$(ZEPHYR_CMSIS_NN_KCONFIG)"
config ZEPHYR_CMSIS_NN_MODULE
	bool
	default y
endmenu
menu "fatfs (/Users/giulio/git/zmk-config-gnf/modules/fs/fatfs)"
osource "$(ZEPHYR_FATFS_KCONFIG)"
config ZEPHYR_FATFS_MODULE
	bool
	default y
endmenu
menu "hal_ambiq (/Users/giulio/git/zmk-config-gnf/modules/hal/ambiq)"
osource "$(ZEPHYR_HAL_AMBIQ_KCONFIG)"
config ZEPHYR_HAL_AMBIQ_MODULE
	bool
	default y
endmenu
menu "hal_espressif (/Users/giulio/git/zmk-config-gnf/modules/hal/espressif)"
osource "/Users/giulio/git/zmk-config-gnf/modules/hal/espressif/zephyr/Kconfig"
config ZEPHYR_HAL_ESPRESSIF_MODULE
	bool
	default y
endmenu
menu "hal_ethos_u (/Users/giulio/git/zmk-config-gnf/modules/hal/ethos_u)"
osource "$(ZEPHYR_HAL_ETHOS_U_KCONFIG)"
config ZEPHYR_HAL_ETHOS_U_MODULE
	bool
	default y
endmenu
menu "hal_gigadevice (/Users/giulio/git/zmk-config-gnf/modules/hal/gigadevice)"
osource "$(ZEPHYR_HAL_GIGADEVICE_KCONFIG)"
config ZEPHYR_HAL_GIGADEVICE_MODULE
	bool
	default y
endmenu
menu "hal_nordic (/Users/giulio/git/zmk-config-gnf/modules/hal/nordic)"
osource "$(ZEPHYR_HAL_NORDIC_KCONFIG)"
config ZEPHYR_HAL_NORDIC_MODULE
	bool
	default y
endmenu
menu "hal_rpi_pico (/Users/giulio/git/zmk-config-gnf/modules/hal/rpi_pico)"
osource "$(ZEPHYR_HAL_RPI_PICO_KCONFIG)"
config ZEPHYR_HAL_RPI_PICO_MODULE
	bool
	default y
endmenu
menu "hal_telink (/Users/giulio/git/zmk-config-gnf/modules/hal/telink)"
osource "/Users/giulio/git/zmk-config-gnf/modules/hal/telink/Kconfig"
config ZEPHYR_HAL_TELINK_MODULE
	bool
	default y
endmenu
menu "liblc3 (/Users/giulio/git/zmk-config-gnf/modules/lib/liblc3)"
osource "$(ZEPHYR_LIBLC3_KCONFIG)"
config ZEPHYR_LIBLC3_MODULE
	bool
	default y
endmenu
menu "littlefs (/Users/giulio/git/zmk-config-gnf/modules/fs/littlefs)"
osource "$(ZEPHYR_LITTLEFS_KCONFIG)"
config ZEPHYR_LITTLEFS_MODULE
	bool
	default y
endmenu
menu "lvgl (/Users/giulio/git/zmk-config-gnf/modules/lib/gui/lvgl)"
osource "/Users/giulio/git/zmk-config-gnf/modules/lib/gui/lvgl/Kconfig"
config ZEPHYR_LVGL_MODULE
	bool
	default y
endmenu
menu "mbedtls (/Users/giulio/git/zmk-config-gnf/modules/crypto/mbedtls)"
osource "$(ZEPHYR_MBEDTLS_KCONFIG)"
config ZEPHYR_MBEDTLS_MODULE
	bool
	default y
endmenu
menu "percepio (/Users/giulio/git/zmk-config-gnf/modules/debug/percepio)"
osource "/Users/giulio/git/zmk-config-gnf/modules/debug/percepio/zephyr/Kconfig"
config ZEPHYR_PERCEPIO_MODULE
	bool
	default y
endmenu
menu "picolibc (/Users/giulio/git/zmk-config-gnf/modules/lib/picolibc)"
osource "/Users/giulio/git/zmk-config-gnf/modules/lib/picolibc/zephyr/Kconfig"
config ZEPHYR_PICOLIBC_MODULE
	bool
	default y
endmenu
menu "segger (/Users/giulio/git/zmk-config-gnf/modules/debug/segger)"
osource "$(ZEPHYR_SEGGER_KCONFIG)"
config ZEPHYR_SEGGER_MODULE
	bool
	default y
endmenu
menu "trusted-firmware-a (/Users/giulio/git/zmk-config-gnf/modules/tee/tf-a/trusted-firmware-a)"
osource "$(ZEPHYR_TRUSTED_FIRMWARE_A_KCONFIG)"
config ZEPHYR_TRUSTED_FIRMWARE_A_MODULE
	bool
	default y
endmenu
menu "uoscore-uedhoc (/Users/giulio/git/zmk-config-gnf/modules/lib/uoscore-uedhoc)"
osource "$(ZEPHYR_UOSCORE_UEDHOC_KCONFIG)"
config ZEPHYR_UOSCORE_UEDHOC_MODULE
	bool
	default y
endmenu
menu "zcbor (/Users/giulio/git/zmk-config-gnf/modules/lib/zcbor)"
osource "$(ZEPHYR_ZCBOR_KCONFIG)"
config ZEPHYR_ZCBOR_MODULE
	bool
	default y
endmenu
menu "module (/Users/giulio/git/zmk-config-gnf/zmk/app/module)"
osource "/Users/giulio/git/zmk-config-gnf/zmk/app/module/Kconfig"
config ZEPHYR_MODULE_MODULE
	bool
	default y
endmenu
```

## config/boards/shields/gnf/Kconfig.defconfig
```kconfig
if SHIELD_GNF_LEFT

config ZMK_KEYBOARD_NAME
    default "GNF v2"

config ZMK_SPLIT_ROLE_CENTRAL
    default y

endif

if SHIELD_GNF_LEFT || SHIELD_GNF_RIGHT

config ZMK_SPLIT
    default y

endif
```

## config/boards/shields/gnf/Kconfig.shield
```kconfig
config SHIELD_GNF_LEFT
    def_bool $(shields_list_contains,gnf_left)

config SHIELD_GNF_RIGHT
    def_bool $(shields_list_contains,gnf_right)
```
